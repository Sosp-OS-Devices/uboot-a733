## configs/sun55iw3p1_t527_nand_defconfig
```kconfig
CONFIG_SUNXI_TEXT_SIZE=0x180000
CONFIG_ARM=y
CONFIG_ARM_SMCCC=y
CONFIG_SYS_TEXT_BASE=0x4A000000
CONFIG_SUNXI_SECURE_BOOT=y
CONFIG_SUNXI_WDT_V2=y
CONFIG_MACH_SUN55IW3=y
CONFIG_R_I2C0_ENABLE=y
CONFIG_USB0_VBUS_PIN="PB12"
CONFIG_USB1_VBUS_PIN="PB3"
CONFIG_DEFAULT_DEVICE_TREE="sun55iw3p1-soc-system"
# CONFIG_SYS_MALLOC_CLEAR_ON_INIT is not set
CONFIG_PHYS_64BIT=y
CONFIG_ANDROID_BOOT_IMAGE=y
CONFIG_SUNXI_SERIAL=y
CONFIG_ANDROID_AB=y
CONFIG_SUNXI_MAC=y
CONFIG_SUNXI_GPIO_POWER_VOL_MODE=y
CONFIG_SUNXI_USER_KEY=y
CONFIG_SUNXI_DRM_SUPPORT=y
CONFIG_SUNXI_ANDROID_BOOT=y
CONFIG_SUNXI_VERIFY_BOOT_INFO_INSTALL=y
CONFIG_SUNXI_NECESSARY_REPLACE_FDT=y
CONFIG_SUNXI_HOMLET=y
CONFIG_RECOVERY_KEY=y
CONFIG_SUNXI_HDCP_IN_SECURESTORAGE=y
CONFIG_SUNXI_RKP=y
CONFIG_CMD_FASTBOOT=y
CONFIG_CMD_PART=y
CONFIG_CMD_USB=y
CONFIG_CMD_AB_SELECT=y
CONFIG_CMD_EXT4=y
CONFIG_CMD_SUNXI_TIMER=y
CONFIG_CMD_SUNXI_CLK=y
CONFIG_CMD_SUNXI_SPRITE=y
CONFIG_CMD_SUNXI_BURN=y
CONFIG_CMD_SUNXI_MEMTEST=y
CONFIG_CMD_SUNXI_BOOTR=y
CONFIG_CMD_SUNXI_BOOTRV=y
CONFIG_CMD_SUNXI_AMP=y
CONFIG_CMD_SUNXI_CE_TEST=y
CONFIG_AIOT_DISP_PARAM_UPDATE=y
CONFIG_AIOT_DISP_PARAM_UPDATE_DEBUG=y
# CONFIG_NET is not set
CONFIG_DM=y
CONFIG_BLOCK_CACHE=y
CONFIG_CLK_SUNXI=y
CONFIG_SUNXI_GPIO_V2=y
CONFIG_SYS_I2C_SUNXI=y
CONFIG_SYS_SUNXI_R_I2C0_SPEED=400000
CONFIG_SYS_SUNXI_R_I2C0_SLAVE=0x35
CONFIG_AXP1530_SUNXI_I2C_SLAVE=0x36
CONFIG_AXP858_SUNXI_I2C_SLAVE=0x36
CONFIG_AXP81X_SUNXI_I2C_SLAVE=0x34
CONFIG_AXP806_SUNXI_I2C_SLAVE=0x36
CONFIG_AXP2202_SUNXI_I2C_SLAVE=0x35
CONFIG_MMC=y
CONFIG_AW_MTD_RAWNAND=y
CONFIG_SPI_FLASH=y
CONFIG_SF_DEFAULT_MODE=0x3000
CONFIG_SF_DEFAULT_SPEED=20000000
CONFIG_SPI_SAMP_DL_EN=y
CONFIG_SPI_FLASH_ATMEL=y
CONFIG_SPI_FLASH_EON=y
CONFIG_SPI_FLASH_GIGADEVICE=y
CONFIG_SPI_FLASH_ISSI=y
CONFIG_SPI_FLASH_MACRONIX=y
CONFIG_SPI_FLASH_SPANSION=y
CONFIG_SPI_FLASH_STMICRO=y
CONFIG_SPI_FLASH_SST=y
CONFIG_SPI_FLASH_WINBOND=y
CONFIG_SPI_FLASH_XMC=y
CONFIG_SPI_FLASH_PUYA=y
CONFIG_SPI_FLASH_FM=y
CONFIG_SPI_FLASH_XT=y
CONFIG_DM_ETH=y
CONFIG_SPI=y
CONFIG_SUNXI_SPI=y
CONFIG_SPI_USE_DMA=y
CONFIG_SUNXI_POWER=y
CONFIG_SUNXI_PMU=y
CONFIG_SUNXI_BMU=y
CONFIG_SUNXI_PMU_EXT=y
CONFIG_AXP858_POWER=y
CONFIG_AXP2202_POWER=y
CONFIG_AXP1530_POWER=y
CONFIG_AXP81X_POWER=y
CONFIG_AXP806_POWER=y
CONFIG_TCS4838_POWER=y
CONFIG_SY8827G_POWER=y
CONFIG_SUNXI_UBOOT_POWER_OFF=y
CONFIG_USB=y
CONFIG_USB_EHCI_HCD=y
CONFIG_USB_STORAGE=y
CONFIG_AW_DRM=y
CONFIG_AW_DRM_LVDS=y
CONFIG_AW_DRM_RGB=y
CONFIG_AW_DRM_DSI=y
CONFIG_AW_DRM_EDP=y
CONFIG_AW_DRM_INNO_EDP13=y
# CONFIG_AW_DRM_EINK200 is not set
CONFIG_AW_DRM_PANEL=y
CONFIG_PANEL_DSI_GENERAL=y
CONFIG_PANEL_LVDS_GENERAL=y
CONFIG_PANEL_RGB_GENERAL=y
CONFIG_PANEL_EDP_GENERAL=y
CONFIG_AW_DRM_PHY=y
CONFIG_SUNXI_COMM_NAND_V1=y
# CONFIG_SUNXI_SPINOR is not set
CONFIG_SUNXI_USB=y
CONFIG_SUNXI_EFEX=y
CONFIG_SUNXI_BURN=y
CONFIG_SUNXI_CE_30=y
CONFIG_SUNXI_RSA_SOFTWARE=y
CONFIG_SUNXI_PHY_KEY=y
CONFIG_SUNXI_LRADC_KEY=y
CONFIG_SUNXI_ARISC_EXIST=y
CONFIG_ARISC_DEASSERT_BEFORE_KERNEL=y
CONFIG_XTENSA_DSP=y
CONFIG_BOOT_RISCV=y
CONFIG_SHA256=y
CONFIG_SUNXI_ANDROID_OVERLAY=y
CONFIG_SUNXI_SPRITE=y
CONFIG_SECURE_STORAGE_KEY_HUK=y
CONFIG_SUNXI_SPRITE_CARTOON=y
CONFIG_SUNXI_UPDATE_GPT=y
CONFIG_SUNXI_BOOT_PARAM=y

#
# sunxi-nand
#
CONFIG_SUNXI_FLASH=y
CONFIG_SUNXI_NAND=y
CONFIG_SUNXI_UBIFS=y
CONFIG_AW_MTD_SPINAND=y
CONFIG_AW_MTD_RAWNAND=y
CONFIG_AW_SPINAND_PHYSICAL_LAYER=y
CONFIG_AW_SPINAND_NONSTANDARD_SPI_DRIVER=y
# CONFIG_AW_SPINAND_ENABLE_PHY_CRC16 is not set
# CONFIG_AW_SPINAND_PSTORE_MTD_PART is not set
CONFIG_AW_MTD_SPINAND_UBOOT_BLKS=24
CONFIG_AW_SPINAND_SIMULATE_MULTIPLANE=y
# CONFIG_AW_MTD_SPINAND_OOB_RAW_SPARE is not set
CONFIG_AW_RAWNAND_SIMULATE_MULTIPLANE=y
# CONFIG_SUNXI_COMP_GZ=y
```

## configs/sun60iw2p1_a733_ssd_defconfig
```kconfig
CONFIG_SUNXI_TEXT_SIZE=0x180000
CONFIG_RESERVE_FDT_SIZE=0x80000
CONFIG_ARM=y
CONFIG_ARM_SMCCC=y
CONFIG_SYS_TEXT_BASE=0x4A000000
CONFIG_SUNXI_SECURE_BOOT=y
CONFIG_SUNXI_WDT_V2=y
CONFIG_MACH_SUN60IW2=y
CONFIG_R_I2C0_ENABLE=y
CONFIG_USB0_VBUS_PIN="PL10"
CONFIG_USB1_VBUS_PIN="PL4"
CONFIG_DEFAULT_DEVICE_TREE="sun60iw2p1-soc-system"
# CONFIG_SYS_MALLOC_F is not set
# CONFIG_SYS_MALLOC_CLEAR_ON_INIT is not set
CONFIG_PHYS_64BIT=y
CONFIG_ANDROID_BOOT_IMAGE=y
CONFIG_SUNXI_SERIAL=y
CONFIG_ANDROID_AB=y
CONFIG_SUNXI_MAC=y
CONFIG_SUNXI_USER_KEY=y
CONFIG_SUNXI_DRM_SUPPORT=y
CONFIG_SUNXI_ANDROID_BOOT=y
CONFIG_SUNXI_VERIFY_BOOT_INFO_INSTALL=y
CONFIG_SUNXI_NECESSARY_REPLACE_FDT=y
CONFIG_SUNXI_HOMLET=y
CONFIG_RECOVERY_KEY=y
CONFIG_SUNXI_HDCP_IN_SECURESTORAGE=y
CONFIG_SUNXI_RKP=y
CONFIG_SUNXI_BOOT_ENV_INLINE=y
CONFIG_SUNXI_BOOT_ENV_STRING="bootcmd=run setargs_nvme boot_normal\n boot_normal=sunxi_flash read 4007f800 boot;bootm 0x4007f800\n boot_recovery=\n boot_fastboot=fastboot\n"
# CONFIG_CMD_EXPORTENV is not set
# CONFIG_CMD_IMPORTENV is not set
# CONFIG_CMD_EDITENV is not set
CONFIG_CMD_FASTBOOT=y
CONFIG_CMD_PART=y
CONFIG_CMD_USB=y
CONFIG_CMD_SUNXI_TIMER=y
CONFIG_CMD_SUNXI_SPRITE=y
CONFIG_CMD_SUNXI_BURN=y
CONFIG_CMD_SUNXI_MEMTEST=y
CONFIG_LAST_PARTITION_NAME="UDISK"
CONFIG_DM=y
CONFIG_SUNXI_GPADC=y
CONFIG_CLK_SUNXI=y
CONFIG_SUNXI_DMA=y
CONFIG_AW_GPIO_V3=y
CONFIG_SYS_I2C_SUNXI=y
CONFIG_SYS_SUNXI_R_I2C0_SLAVE=0x34
CONFIG_AXP8191_SUNXI_I2C_SLAVE=0x36
CONFIG_AXP515_SUNXI_I2C_SLAVE=0x34
CONFIG_MMC=y
CONFIG_UFS=y
CONFIG_SUNXI_POWER=y
CONFIG_SUNXI_PMU=y
CONFIG_SUNXI_BMU=y
CONFIG_AXP515_POWER=y
CONFIG_AXP8191_POWER=y
CONFIG_SUNXI_UBOOT_POWER_OFF=y
CONFIG_USB=y
CONFIG_USB_EHCI_HCD=y
CONFIG_USB_STORAGE=y
CONFIG_AW_DRM=y
CONFIG_AW_DRM_LVDS=y
CONFIG_AW_DRM_DSI=y
# CONFIG_AW_DRM_EINK200 is not set
CONFIG_AW_DRM_PANEL=y
CONFIG_PANEL_DSI_GENERAL=y
CONFIG_PANEL_LVDS_GENERAL=y
CONFIG_AW_DRM_PHY=y
CONFIG_SUNXI_SDMMC=y
CONFIG_SUNXI_BOOT0_SDMMC_BACKUP_START_ADDR=2064
CONFIG_SUNXI_UFS=y
CONFIG_SUNXI_USB=y
CONFIG_SUNXI_EFEX=y
CONFIG_SUNXI_BURN=y
CONFIG_SUNXI_CE_30=y
CONFIG_SUNXI_ARISC_EXIST=y
CONFIG_ARISC_DEASSERT_BEFORE_KERNEL=y
CONFIG_SUNXI_ANDROID_OVERLAY=y
CONFIG_SUNXI_SPRITE=y
CONFIG_SUNXI_SPRITE_CARTOON=y
CONFIG_SUNXI_AUTO_UPDATE=y
CONFIG_SUNXI_AUTO_UPDATE_CHECK=y
CONFIG_SUNXI_UPDATE_GPT=y
CONFIG_SUNXI_BOOT_PARAM=y
CONFIG_SUNXI_TURNNING_DRAM=y
CONFIG_SPI=y
CONFIG_SUNXI_SPI=y
CONFIG_SPI_USE_DMA=y
CONFIG_SPI_FLASH=y
CONFIG_SPI_FLASH_WINBOND=y
CONFIG_SPI_FLASH_EON=y
CONFIG_SPI_FLASH_GIGADEVICE=y
CONFIG_SPI_FLASH_ISSI=y
CONFIG_SPI_FLASH_MACRONIX=y
CONFIG_SPI_FLASH_SPANSION=y
CONFIG_SPI_FLASH_ATMEL=y
CONFIG_SPI_FLASH_STMICRO=y
CONFIG_SPI_FLASH_SST=y
CONFIG_SPI_FLASH_PUYA=y
CONFIG_SPI_FLASH_FM=y
CONFIG_SPI_FLASH_XT=y
CONFIG_SPI_FLASH_ADESTO=y
CONFIG_SPI_FLASH_XMC=y
CONFIG_SPI_SAMP_DL_EN=y
CONFIG_SF_DEFAULT_MODE=0x3000
CONFIG_SF_DEFAULT_SPEED=20000000
CONFIG_SPINOR_UBOOT_OFFSET=560
CONFIG_SPINOR_LOGICAL_OFFSET=4224
CONFIG_SPINOR_LOGICAL_SECURE_OFFSET=4224
CONFIG_SPINOR_UBOOT_SECURE_OFFSET=560
CONFIG_SUNXI_SPINOR=y
CONFIG_SUNXI_DUAL_STORAGE=y

# pcie nvme
CONFIG_CMD_NVME=y
CONFIG_CMD_PCI=y
CONFIG_NVME=y
CONFIG_SUNXI_NVME=y
CONFIG_PCI=y
CONFIG_DM_PCI=y
CONFIG_PCIE_ALLWINNER_RC=y
CONFIG_PCIE_PERST_GPIO="PE13"
CONFIG_PCIE_WAKE_GPIO="PE12"
CONFIG_PCIE_PWREN_GPIO="PL12"
CONFIG_AW_CADENCE_COMBOPHY=y

# ethernet
CONFIG_NET=y
CONFIG_NETDEVICES=y
CONFIG_PHYLIB=y
CONFIG_DM_ETH=y
CONFIG_SUNXI_DWMAC=y
CONFIG_AW_DWMAC=y
CONFIG_RMII=y
CONFIG_RGMII=y
CONFIG_PHY_GIGE=y
CONFIG_PHY_REALTEK=y
CONFIG_CMD_MII=y
CONFIG_CMD_PING=y
OCNFIG_CMD_NET=y
CONFIG_CMD_TFTPBOOT=y
```

## drivers/sunxi_flash/nvme/Kconfig
```kconfig
config SUNXI_NVME
	bool "support sunxi nvme devices"
	depends on SUNXI_FLASH && NVME
	default n
	help
	  enable support for sunxi nvme devices. these provide a block-level interface which permits
	  reading, writing and (in some cases) erasing blocks.


if SUNXI_NVME
config NVME_LOGICAL_OFFSET
	int "logic address for read/write"
	default 40960
	help
	  logic address for mbr and partitions(1M-MBRSIZE = 2048-32).
	  NVME address is offset*512 bytes.

endif
```

## drivers/video/drm/bridge/Kconfig
```kconfig
# SPDX-License-Identifier: GPL-2.0-or-later

menuconfig AW_DRM_BRIDGE
	bool "Support DRM Bridge"
	depends on AW_DRM
	default n
	help
		If you want support bridge function for drm driver, select it.

config SUNXI_SIMPLE_DRM_BRIDGE
	bool "sunxi simple drm bridge"
	depends on (AW_DRM_BRIDGE)
	default n
	help
		If you want to support sunxi simple drm bridge, select it.

config AW_DRM_BRIDGE_LT8711
	bool "Support LT8711 DP To HDMI Output"
	depends on AW_DRM_BRIDGE
	default n
	help
		If you want support LT8711 output for drm driver, select it.

config AW_DRM_BRIDGE_GM7123
	bool "Support GM7123 RGB To VGA Output"
	depends on AW_DRM_BRIDGE
	default n
	help
		If you want support GM7123 output for drm driver, select it.
```
